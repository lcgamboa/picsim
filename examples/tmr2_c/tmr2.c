;	LIST P=16F628A
	INCLUDE <p16f628a.inc>
	__CONFIG _CP_OFF & _WDT_OFF & _PWRTE_OFF & _BODEN_OFF & _MCLRE_OFF & _INTRC_OSC_NOCLKOUT & _LVP_OFF


        CBLOCK 0x20
        CNT
        ENDC 

	ORG 0X0000
	GOTO INICIO

	ORG 0x0004
        DECFSZ CNT,F
        GOTO FIMI
	MOVLW	0XFF
	XORWF   PORTB,F
        MOVLW   0x0F
        MOVWF   CNT

FIMI:	BCF PIR1,TMR2IF			
	RETFIE

INICIO:
	MOVLW B'00000111'
	MOVWF CMCON

	CLRF	INTCON
	
	BANKSEL TRISB
	MOVLW B'00000000'
	MOVWF   TRISB
	BSF PIE1,TMR2IE

	BANKSEL PORTB

	MOVLW 0X7F
	MOVWF T2CON

	MOVLW 0xFF
	MOVWF PORTB
	

        MOVLW 0x0F
        MOVWF CNT

	BCF PIR1,TMR2IF
	BSF INTCON,GIE
	BSF INTCON,PEIE			
			

LOOP:

	GOTO LOOP

	END

