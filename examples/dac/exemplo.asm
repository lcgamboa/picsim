
	 #include <p16f628a.inc>

    	__CONFIG _WDT_OFF & _PWRTE_OFF & _INTOSC_OSC_NOCLKOUT & _MCLRE_OFF & _BOREN_OFF & _LVP_OFF & _DATA_CP_OFF & _CP_OFF

	CBLOCK 0X20
	_A
	_B
	_C
	ENDC

 	ORG 0x00
start:  MOVLW 0x03
	MOVWF _A
	MOVLW 0x02
	MOVWF _B
	MOVLW 0x01
	MOVWF _C

	MOVLW 2
	SUBWF _A,W
	
	MOVLW 2
	SUBWF _B,W

	MOVLW 2
	SUBWF _C,W

	MOVLW 0x01
	SUBLW 0x02

	MOVLW 0x02
	SUBLW 0x02

	MOVLW 0x03
	SUBLW 0x02

	CLRW
	CLRF _A
	INCF _A,F
	INCF _A,W
	DECF _B,F
	DECF _B,W
	NOP
	MOVLW 0x12
	MOVWF _C
	INCF  _C,W
	NOP
	NOP
	NOP
	CLRF 	_A
	BSF	_A,0
	BSF	_A,1
	BSF	_A,2
	BSF	_A,3
	BSF	_A,4
	BSF	_A,5
	BSF	_A,6
	BSF	_A,7
	NOP
	BCF	_A,0
	BCF	_A,1
	BCF	_A,2
	BCF	_A,3
	BCF	_A,4
	BCF	_A,5
	BCF	_A,6
	BCF	_A,7
	NOP
	NOP
	NOP
	BANKSEL TRISB
	MOVLW B'00000000'
	MOVWF TRISB
	BANKSEL PORTB
	CLRF PORTB
	INCF PORTB,F
LOOP:	CALL DELAY
	CALL DELAY
;	BCF STATUS,C
;	RLF PORTB,F
;	BTFSC STATUS,C
	INCF PORTB,f
	GOTO LOOP
DELAY	MOVLW  0XFF
	MOVWF  _C
	DECFSZ _C
	GOTO $-1
	RETURN
	END
