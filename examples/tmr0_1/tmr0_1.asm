;	LIST P=16F628A
	INCLUDE <p16f628a.inc>
	__CONFIG _CP_OFF & _WDT_OFF & _PWRTE_OFF & _BODEN_OFF & _MCLRE_ON & _INTRC_OSC_NOCLKOUT & _LVP_OFF


        CBLOCK 0x20
        CNT0
	CNT1
        ENDC 

	ORG 0X0000
	GOTO INICIO

	ORG 0x0004

	BTFSC INTCON,T0IF
	GOTO TR0_INT
TR1_INT:
	DECFSZ  CNT1,F
        GOTO    FIMI1
	MOVLW	0XF0
	XORWF   PORTB,F
        MOVLW   0x02
        MOVWF   CNT1

FIMI1:	BCF PIR1,TMR1IF		
	RETFIE
TR0_INT:
        DECFSZ CNT0,F
        GOTO FIMI0
	MOVLW	0X0F
	XORWF   PORTB,F
        MOVLW   0x28
        MOVWF   CNT0

FIMI0:	MOVLW	d'55'
	MOVWF	TMR0
	BCF INTCON,T0IF			
	RETFIE

INICIO:
	MOVLW B'00000111'
	MOVWF CMCON

	CLRF	INTCON
	
	BANKSEL TRISB
	MOVLW B'00000000'
	MOVWF   TRISB

	BCF OPTION_REG,T0CS
	BCF OPTION_REG,PSA
	
	BSF OPTION_REG,PS2
	BSF OPTION_REG,PS1
        BSF OPTION_REG,PS0

	BSF PIE1,TMR1IE
	
	BANKSEL PORTB

	MOVLW	d'55'
	MOVWF	TMR0
	
	MOVLW 0X31
	MOVWF T1CON
        
	CLRF PORTB

        MOVLW 0x28
        MOVWF CNT0

 	MOVLW 0x2
        MOVWF CNT1

	BSF INTCON,GIE
	BSF INTCON,T0IE	
	BCF INTCON,T0IF
	BSF INTCON,PEIE			
	BCF PIR1,TMR1IF
		
LOOP:

	GOTO LOOP

	END

