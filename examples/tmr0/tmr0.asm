;	LIST P=16F628A
	INCLUDE <p16f628a.inc>
	__CONFIG _CP_OFF & _WDT_OFF & _PWRTE_OFF & _BODEN_OFF & _MCLRE_OFF & _INTRC_OSC_NOCLKOUT & _LVP_OFF


        CBLOCK 0x20
        CNT
        ENDC 

	ORG 0X0000
	GOTO INICIO

	ORG 0x0004
        DECFSZ CNT,F
        GOTO FIMI
	MOVLW	0XFF
	XORWF   PORTB,F
        MOVLW   0x14
        MOVWF   CNT

FIMI:	MOVLW	d'55'
	MOVWF	TMR0
	BCF INTCON,T0IF			
	RETFIE

INICIO:
	MOVLW B'00000111'
	MOVWF CMCON

	CLRF	INTCON
	
	BANKSEL TRISB
	MOVLW B'00000000'
	MOVWF   TRISB

	BCF OPTION_REG,T0CS
	BCF OPTION_REG,PSA
	
	BSF OPTION_REG,PS2
	BSF OPTION_REG,PS1
        BSF OPTION_REG,PS0

	BANKSEL PORTB

	MOVLW	d'55'
	MOVWF	TMR0

	MOVLW 0xFF
	MOVWF PORTB

        MOVLW 0x14
        MOVWF CNT

	BSF INTCON,GIE
	BSF INTCON,T0IE	
	BCF INTCON,T0IF			

LOOP:

	GOTO LOOP

	END

